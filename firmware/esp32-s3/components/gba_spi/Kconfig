## firmware/esp32-s3/components/gba_spi/Kconfig
```kconfig
menu "GBA SPI-slave front-end (experimental)"

config GBA_SPI_DIRECT_SELFTEST
    bool "Run the GBA SPI-slave self-test at boot (skips LDN)"
    default n
    help
        When set, app_main() runs gba_spi_selftest() (design doc §8 gate 1/2) instead of the LDN
        join, logging the 32-bit words the GBA clocks in so the SPI mode + wiring can be confirmed.
        Leave OFF for the normal two-chip LDN firmware.

config GBA_SPI_TRADE_RELAY_SELFTEST
    bool "Run the Phase 1 trade-relay self-test at boot (skips LDN)"
    default n
    help
        When set, app_main() runs gba_spi_trade_relay_selftest() instead of the LDN join: the bare
        core1 GBA adapter wired to the REAL gba_relay backend with a synthetic Switch peer seeded,
        so the discover->connect->slot-exchange flow can be validated against a real cartridge in
        the TRADE counter, without real Wi-Fi yet (docs/16-single-chip-trade-plan.md, Phase 1).
        Mutually exclusive with GBA_SPI_DIRECT_SELFTEST in practice (both start core1). Leave OFF
        for the normal LDN firmware.

config GBA_SPI_BUS_PROBE
    bool "Run the GPIO bus-stall probe at boot (skips LDN)"
    default n
    help
        When set, app_main() runs gba_spi_bus_probe() instead of the LDN join: bare core 1 times
        every back-to-back GPIO_IN_REG read (ccount deltas, min/max/threshold buckets) while
        core 0 cycles 5-second load phases (quiet, UART log spam, flash-read churn, PSRAM memcpy
        churn, all-at-once). Answers docs/17 section 7's open question on-device: can core-0 bus
        traffic stall a core-1 GPIO read past the 250ns half-bit budget? No GBA needs to be
        connected. Mutually exclusive with the other GBA_SPI_* selftests. Leave OFF normally.

config GBA_SPI_CLOCK_MASTER
    bool "Take the SIO clock on a role-change ack (trade data phase)"
    default n
    help
        The RFU clock role swaps: acking 0x25/0x27/0x35/0x37 with the correct cmd|0x80 ack
        (A5/A7/B5/B7) puts the GBA into clock-slave mode, after which it STOPS DRIVING SC and
        waits for the adapter to clock the link. With this OFF the transport keeps sending the
        legacy (wrong but harmless) 0xA8 ack and never takes the clock — the GBA stays clock
        master, which is what every run so far has used. With it ON the adapter sends the correct
        ack and drives SC itself via the dedicated-GPIO clock-master path.
        These two must change together: the correct ack without clock-master drive silences the
        link permanently, and clock-master drive without the correct ack never gets the role.
        UNPROVEN ON HARDWARE — this is the gate for the trade DATA phase. Turn on to test it.

config GBA_SPI_MODE
    int "SPI slave mode (0-3) for the GBA link"
    default 3
    range 0 3
    help
        SPI CPOL/CPHA for the GBA link. Start at 3 (design doc §2); if login words read bit-shifted
        or garbled, try 0. This is the first go/no-go dial.

endmenu
```
